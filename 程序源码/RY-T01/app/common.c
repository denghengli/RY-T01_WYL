#include "includes.h"


/*
*********************************************************************************************************
*	函 数 名: LOG_Printf
*	功能说明: 线程安全的串口打印，使用互斥量进行保护
*	形    参: 无
*	返 回 值: 无
*********************************************************************************************************
*/
void LOG_PRINT(char n,char *format, ...)
{
  
#if UART_DEG_EN
  
    char     buf_str[150 + 1];
    va_list   v_args;

    if(n)
    {
        va_start(v_args, format);
        
        (void)vsnprintf((char       *)&buf_str[0],
                        (size_t       ) sizeof(buf_str),
                        (char const *) format,
                        v_args);
         
        va_end(v_args);
        /*获取互斥信号量*/
        xSemaphoreTake(MutexPrint, portMAX_DELAY);
        /*打印输出*/
        printf("%s", buf_str);
        /*释放信号量*/
       xSemaphoreGive(MutexPrint);
    }
    
#endif
  
}



/*
*********************************************************************************************************
*	函 数 名: CoarseDelay
*	功能说明: 粗糙延时
*	形    参: _dly   延时时长
*	返 回 值: NULL
*********************************************************************************************************
*/
void CoarseDelay(unsigned int _dly)
{
	do
	{
		_dly--;
	}
	while(_dly);
}

/*
*********************************************************************************************************
*	函 数 名: Delay_us
*	功能说明: 粗糙延时us
*	形    参: _dly   延时时长
*	返 回 值: NULL
*********************************************************************************************************
*/
void Delay_us(unsigned int _us)
{     
        
        unsigned int delta;
        
        _us = _us * (SysTick->LOAD / (1000000 / configTICK_RATE_HZ));
        
        delta = SysTick->VAL;
        
        if (delta < _us)
        {
          /* wait current OSTick left time gone */
          while (SysTick->VAL < _us);
          
          _us -= delta;
          
          delta = SysTick->LOAD;
        }
        
        while (delta - SysTick->VAL < _us);
        
}	

/*
*********************************************************************************************************
*	函 数 名: Delay_Ms
*	功能说明: 精确延时ms
*	形    参: _ms   延时时长
*	返 回 值: NULL
*********************************************************************************************************
*/
void Delay_Ms(unsigned int _ms)
{
	HAL_Delay(_ms);
}


/*
*********************************************************************************************************
*	函 数 名: BubbleSort
*	功能说明: 冒泡排序，从小到大
*	形    参: arr数组 ；size 长度
*	返 回 值: NULL
*********************************************************************************************************
*/
void BubbleSort(int *arr,int size)
{
    int i = 0,j = 0;
    int tmp = 0;
    
    for(i=0;i<size-1;i++)
    {
        for(j=0;j<size-i-1;j++)
        {
            if(arr[j] > arr[j+1])
            {
                tmp = arr[j];
                arr[j] = arr[j+1];
                arr[j+1] = tmp;
            }
        }
    }       
}



/*
*********************************************************************************************************
*	函 数 名: FloatLimit
*	功能说明: 浮点数据小数位长度限制，保留n位小数
*	形    参: fDat浮点数 ；n 小数保留位数
*	返 回 值: NONE
*********************************************************************************************************
*/
void FloatLimit(float *fDat,unsigned char n)
{
    float *temp = NULL;
    
    temp = fDat;
    *temp = (float)((int)(*temp * pow(10,n))) /pow(10,n);
    
}


/*
*********************************************************************************************************
*	函 数 名: UHUL_TO_U16
*	功能说明: 字符转换
*	形    参: _cPtr   数据指针
*	返 回 值: short数据
*********************************************************************************************************
*/
unsigned short UHUL_TO_U16(unsigned char *_cptr)
{
    unsigned short shTemp = 0;
    
    shTemp = _cptr[0];
    shTemp = shTemp << 8 | _cptr[1];
    
    return shTemp;
//	return (((unsigned short)_cptr[0] << 8) | _cptr[1]);
}

/*
*********************************************************************************************************
*	函 数 名: UHUL_TO_U16
*	功能说明: 字符转换
*	形    参: _cPtr   数据指针
*	返 回 值: short数据
*********************************************************************************************************
*/
unsigned short ULUH_TO_U16(unsigned char *_cptr)
{
    unsigned short shTemp = 0;
    
    shTemp = _cptr[1];
    shTemp = shTemp << 8 | _cptr[0];
    
    return shTemp;
//	return (((unsigned short)_cptr[1] << 8) | _cptr[0]);
}


/*
*********************************************************************************************************
*	函 数 名: str_len
*	功能说明: 计算字符串长度.0是结束符
*	形    参: _str : 缓冲区
*	返 回 值: 无
*********************************************************************************************************
*/
int str_len(char *_str)
{
	int len = 0;

	while (*_str++) len++;
	return len;
}

/*
*********************************************************************************************************
*	函 数 名: str_cpy
*	功能说明: 复制字符串
*	形    参: tar : 目标缓冲区
*			 src : 源缓冲区
*	返 回 值: 无
*********************************************************************************************************
*/
void str_cpy(char *_tar, char *_src)
{
	do
	{
		*_tar++ = *_src;
	}
	while (*_src++);
}

/*
*********************************************************************************************************
*	函 数 名: str_cmp
*	功能说明: 字符串比较
*	形    参: s1 : 字符串1
*			  s2 : 字符串2
*	返 回 值: 0 表示相等 非0表示不等
*********************************************************************************************************
*/
int str_cmp(char * s1, char * s2)
{
	while ((*s1!=0) && (*s2!=0) && (*s1==*s2))
	{
		s1++;
		s2++;
	}
	return *s1 - *s2;
}

/*
*********************************************************************************************************
*	函 数 名: str_copy
*	功能说明: 复制字符串
*	形    参: tar : 目标缓冲区
*			 src : 源缓冲区
*	返 回 值: 无
*********************************************************************************************************
*/
void mem_set(char *_tar, char _data, int _len)
{
	while (_len--)
	{
		*_tar++ = _data;
	}
}

/*
*********************************************************************************************************
*	函 数 名: int_to_ascii
*	功能说明: 将整数转换为ASCII数组。支持负数。
*	形    参: _Number : 整数
*			 _pBuf : 目标缓冲区, 存放转换后的结果。以0结束的字符串。
*			 _len : ASCII字符个数, 字符串长度
*	返 回 值: 无
*********************************************************************************************************
*/
void int_to_str(int _iNumber, char *_pBuf, unsigned char _len)
{
	unsigned char i;
	int iTemp;

	if (_iNumber < 0)	/* 负数 */
	{
		iTemp = -_iNumber;	/* 转为正数 */
	}
	else
	{
		iTemp = _iNumber;
	}

	mem_set(_pBuf, ' ',_len);

	/* 将整数转换为ASCII字符串 */
	for (i = 0; i < _len; i++)
	{
		_pBuf[_len - 1 - i] = (iTemp % 10) + '0';
		iTemp = iTemp / 10;
		if (iTemp == 0)
		{
			break;
		}
	}
	_pBuf[_len] = 0;

	if (_iNumber < 0)	/* 负数 */
	{
		for (i = 0; i < _len; i++)
		{
			if ((_pBuf[i] == ' ') && (_pBuf[i + 1] != ' '))
			{
				_pBuf[i] = '-';
				break;
			}
		}
	}
}

/*
*********************************************************************************************************
*	函 数 名: str_to_int
*	功能说明: 将ASCII码字符串转换成整数。 遇到小数点自动越过。
*	形    参: _pStr :待转换的ASCII码串. 可以以逗号，#或0结束。 2014-06-20 修改为非0-9的字符。
*	返 回 值: 二进制整数值
*********************************************************************************************************
*/
int str_to_int(char *_pStr)
{
	unsigned char flag;
	char *p;
	int ulInt;
	unsigned char  i;
	unsigned char  ucTemp;

	p = _pStr;
	if (*p == '-')
	{
		flag = 1;	/* 负数 */
		p++;
	}
	else
	{
		flag = 0;
	}

	ulInt = 0;
	for (i = 0; i < 15; i++)
	{
		ucTemp = *p;
		if (ucTemp == '.')	/* 遇到小数点，自动跳过1个字节 */
		{
			p++;
			ucTemp = *p;
		}
		if ((ucTemp >= '0') && (ucTemp <= '9'))
		{
			ulInt = ulInt * 10 + (ucTemp - '0');
			p++;
		}
		else
		{
			break;
		}
	}

	if (flag == 1)
	{
		return -ulInt;
	}
	return ulInt;
}

/*
*********************************************************************************************************
*	函 数 名: BEBufToUint16
*	功能说明: 将2字节数组(大端Big Endian次序，高字节在前)转换为16位整数
*	形    参: _pBuf : 数组
*	返 回 值: 16位整数值
*
*   大端(Big Endian)与小端(Little Endian)
*********************************************************************************************************
*/
unsigned short BEBufToUint16(unsigned char *_pBuf)
{
    return (((unsigned short)_pBuf[0] << 8) | _pBuf[1]);
}

/*
*********************************************************************************************************
*	函 数 名: LEBufToUint16
*	功能说明: 将2字节数组(小端Little Endian，低字节在前)转换为16位整数
*	形    参: _pBuf : 数组
*	返 回 值: 16位整数值
*********************************************************************************************************
*/
unsigned short LEBufToUint16(unsigned char *_pBuf)
{
    return (((unsigned short)_pBuf[1] << 8) | _pBuf[0]);
}


/*
*********************************************************************************************************
*	函 数 名: BEBufToUint32
*	功能说明: 将4字节数组(大端Big Endian次序，高字节在前)转换为32位整数
*	形    参: _pBuf : 数组
*	返 回 值: 32位整数值
*
*   大端(Big Endian)与小端(Little Endian)
*********************************************************************************************************
*/
unsigned int  BEBufToUint32(unsigned char *_pBuf)
{
    return (((unsigned int )_pBuf[0] << 24) | ((unsigned int )_pBuf[1] << 16) | ((unsigned int )_pBuf[2] << 8) | _pBuf[3]);
}

/*
*********************************************************************************************************
*	函 数 名: LEBufToUint32
*	功能说明: 将4字节数组(小端Little Endian，低字节在前)转换为32位整数
*	形    参: _pBuf : 数组
*	返 回 值: 32位整数值
*********************************************************************************************************
*/
unsigned int  LEBufToUint32(unsigned char *_pBuf)
{
    return (((unsigned int )_pBuf[3] << 24) | ((unsigned int )_pBuf[2] << 16) | ((unsigned int )_pBuf[1] << 8) | _pBuf[0]);
}

/*
*********************************************************************************************************
*	函 数 名: LEStructUint16Chg
*	功能说明: 将2字节高低位互换(小端Little Endian，低字节在前)
*	形    参: _shdat : 原始数据
*	返 回 值: 16位重组数据
*********************************************************************************************************
*/
unsigned short LEStructUint16Chg(unsigned short _shdat)
{
	unsigned short shRet;
	shRet = (_shdat << 8 ) | (_shdat >> 8);
	return shRet;
}


/*
*********************************************************************************************************
*	函 数 名: LEStructUint32Chg
*	功能说明: 将4字节高低位互换(小端Little Endian，低字节在前)
*	形    参: _shdat : 原始数据
*	返 回 值: 32位重组数据
*********************************************************************************************************
*/
unsigned int LEStructUint32Chg(unsigned int _idat)
{
	unsigned int   iRet;
	iRet = (_idat << 24 & 0xF000) | (_idat << 8 & 0x0F00) | (_idat >> 8 & 0x00F0) | (_idat >> 24 & 0x000F);
	return iRet;
}





